
CFLAGS += -DLV_CONF_INCLUDE_SIMPLE -DLV_LVGL_H_INCLUDE_SIMPLE
MODULES += core/lib/gui
MODULES += core/lib/gui/lvgl-8.1/drivers
MODULES += core/lib/gui/lvgl-8.1/src
MODULES += core/lib/gui/lvgl-8.1/src/core
MODULES += core/lib/gui/lvgl-8.1/src/draw
MODULES += core/lib/gui/lvgl-8.1/src/font
MODULES += core/lib/gui/lvgl-8.1/src/hal
MODULES += core/lib/gui/lvgl-8.1/src/misc
MODULES += core/lib/gui/lvgl-8.1/src/widgets
MODULES += core/lib/gui/lvgl-8.1/src/extra
MODULES += core/lib/gui/lvgl-8.1/src/extra/themes
MODULES += core/lib/gui/lvgl-8.1/src/extra/themes/mono
MODULES += core/lib/gui/lvgl-8.1/src/extra/themes/default
MODULES += core/lib/gui/lvgl-8.1/src/extra/themes/basic
MODULES += core/lib/gui/lvgl-8.1/src/extra/layouts/flex
MODULES += core/lib/gui/lvgl-8.1/src/extra/layouts/grid
MODULES += core/lib/gui/lvgl-8.1/src/extra/widgets/animimg
MODULES += core/lib/gui/lvgl-8.1/src/extra/widgets/calendar
MODULES += core/lib/gui/lvgl-8.1/src/extra/widgets/chart
MODULES += core/lib/gui/lvgl-8.1/src/extra/widgets/colorwheel
MODULES += core/lib/gui/lvgl-8.1/src/extra/widgets/imgbtn
MODULES += core/lib/gui/lvgl-8.1/src/extra/widgets/keyboard
MODULES += core/lib/gui/lvgl-8.1/src/extra/widgets/led
MODULES += core/lib/gui/lvgl-8.1/src/extra/widgets/list
MODULES += core/lib/gui/lvgl-8.1/src/extra/widgets/meter
MODULES += core/lib/gui/lvgl-8.1/src/extra/widgets/msgbox
MODULES += core/lib/gui/lvgl-8.1/src/extra/widgets/span
MODULES += core/lib/gui/lvgl-8.1/src/extra/widgets/spinbox
MODULES += core/lib/gui/lvgl-8.1/src/extra/widgets/spinner
MODULES += core/lib/gui/lvgl-8.1/src/extra/widgets/tabview
MODULES += core/lib/gui/lvgl-8.1/src/extra/widgets/tileview
MODULES += core/lib/gui/lvgl-8.1/src/extra/widgets/win

